## boards/shields/Enigma_01_Pro/Kconfig.defconfig
```kconfig
if SHIELD_Enigma_01_Pro

# Basic
config ZMK_KEYBOARD_NAME
    default "Enigma_01 Pro"

config ZMK_USB
	default y

config ZMK_BLE
	default y

endif
```

## boards/shields/Enigma_01_Pro/Kconfig.shield
```kconfig
config SHIELD_Enigma_01_Pro
    def_bool $(shields_list_contains,Enigma_01_Pro)

config SHIELD_Enigma_01_Pro_a
    def_bool $(shields_list_contains,Enigma_01_Pro_a)

config SHIELD_Enigma_01_Pro_b
    def_bool $(shields_list_contains,Enigma_01_Pro_b)

config SHIELD_Enigma_01_Pro_c
    def_bool $(shields_list_contains,Enigma_01_Pro_c)
```
